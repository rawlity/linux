/dts-v1/;
#include "bcm2835.dtsi"
#include "bcm2835-rpi.dtsi"

/ {
	compatible = "raspberrypi,model-a", "brcm,bcm2835";
	model = "Raspberry Pi Model A";

	leds {
		act {
			gpios = <&gpio 16 1>;
		};
	};
};

&i2s {
	pinctrl-names = "default";
	pinctrl-0 = <&pcm_gpio28>;
};
