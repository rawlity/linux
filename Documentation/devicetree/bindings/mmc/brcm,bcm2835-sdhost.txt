## Documentation/devicetree/bindings/mmc/brcm,bcm2835-sdhost.txt
```
Broadcom BCM2835 SDHOST controller

This file documents differences between the core properties described
by mmc.txt and the properties that represent the BCM2835 SDHOST controller.

Required properties:
- compatible:	Must be "brcm,bcm2835-sdhost"
- clocks:	The phandle for the clock feeding the SDHOST controller

Optional properties:
- dmas:		DMA channel phandles for read and write
- dma-names:	DMA channel names for read and write, must be "rx" and "tx"
	          See Documentation/devicetree/bindings/dma/dma.txt for details

Example:

sdhost: sdhost@7e202000 {
	compatible = "brcm,bcm2835-sdhost";
	reg = <0x7e202000 0x100>;
	interrupts = <2 24>;
	clocks = <&clocks BCM2835_CLOCK_VPU>;
	dmas = <&dma 13>,
	       <&dma 13>;
	dma-names = "tx", "rx";
};
```
